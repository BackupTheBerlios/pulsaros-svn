## branches/0.5alpha/packages/btrfsprogs/Config.in
```kconfig
config BR2_PACKAGE_BTRFSPROGS
	bool "btrsfsprogs"
	help
	  BTRFS progrs to maintain the btrfs filesystem

	  http://www.kernel.org/pub/linux/kernel/people/mason/btrfs
```

## branches/0.5alpha/packages/syslinux/Config.in
```kconfig
config BR2_PACKAGE_SYSLINUX
	bool "syslinux"
	help
	  SYSLINUX boot loader

	  http://www.kernel.org/pub/linux/utils/boot/syslinux/
```
